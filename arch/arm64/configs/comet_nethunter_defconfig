## arch/arm64/configs/comet_nethunter_defconfig
```kconfig
# private/google-modules/radio/samsung/s5400/Kconfig
CONFIG_EXYNOS_MODEM_IF=m
CONFIG_SEC_MODEM_S5100=m
CONFIG_SHM_IPC=m
CONFIG_CP_PKTPROC=m
CONFIG_CP_PKTPROC_UL=m
CONFIG_MODEM_IF_QOS=m
CONFIG_CPIF_AP_SUSPEND_DURING_VOICE_CALL=y
CONFIG_CPIF_TP_MONITOR=m
CONFIG_LINK_DEVICE_PCIE_SOC_EXYNOS=y
CONFIG_LINK_DEVICE_PCIE_IOCC=y
CONFIG_LINK_DEVICE_PCIE_IOMMU=y
CONFIG_CH_EXTENSION=m
CONFIG_CP_THERMAL=m
CONFIG_CP_PMIC=m

# private/google-modules/touch/common/Kconfig
CONFIG_TOUCHSCREEN_TBN=m
CONFIG_TOUCHSCREEN_TBN_AOC_CHANNEL_MODE=y
CONFIG_TOUCHSCREEN_OFFLOAD=m
CONFIG_GOOG_TOUCH_INTERFACE=m

# private/google-modules/touch/sec/Kconfig
CONFIG_TOUCHSCREEN_SEC_TS=m

# WiFi core
CONFIG_CFG80211=m
CONFIG_MAC80211=m

# Atheros / ath9k_htc (AR9271, AR7010)
CONFIG_WLAN_VENDOR_ATH=y
CONFIG_ATH9K_HTC=m
CONFIG_CARL9170=m

# ath10k USB
CONFIG_ATH10K=m
CONFIG_ATH10K_USB=m

# Realtek USB
CONFIG_WLAN_VENDOR_REALTEK=y
CONFIG_RTL8187=m
CONFIG_RTL8XXXU=m
CONFIG_RTL8XXXU_UNTESTED=y

# Ralink/MediaTek USB
CONFIG_WLAN_VENDOR_RALINK=y
CONFIG_RT2800USB=m
CONFIG_RT2800USB_RT33XX=y
CONFIG_RT2800USB_RT35XX=y
CONFIG_RT2800USB_RT3573=y
CONFIG_RT2800USB_RT53XX=y
CONFIG_RT2800USB_RT55XX=y
CONFIG_RT2800USB_UNKNOWN=y

CONFIG_WLAN_VENDOR_MEDIATEK=y
CONFIG_MT7601U=m

# Broadcom USB
CONFIG_WLAN_VENDOR_BROADCOM=y
CONFIG_BRCMFMAC=m
CONFIG_BRCMFMAC_USB=y
```
